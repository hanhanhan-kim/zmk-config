## boards/petejohanson/technikable/Kconfig.defconfig
```kconfig
# SPDX-License-Identifier: MIT

if BOARD_TECHNIKABLE

config ZMK_KEYBOARD_NAME
	default "Technikable"

if USB_DEVICE_STACK

config USB_NRFX
	default y

endif # USB_DEVICE_STACK

config BT_CTLR
	default BT

endif # BOARD_TECHNIKABLE
```

## config/boards/petejohanson/technikable/Kconfig.technikable
```kconfig
# SPDX-License-Identifier: MIT

config BOARD_TECHNIKABLE
	select SOC_NRF52840_QIAA
	select ZMK_BOARD_COMPAT if BOARD_TECHNIKABLE_NRF52840_ZMK
	imply RETAINED_MEM if BOARD_TECHNIKABLE_NRF52840_ZMK
	imply RETENTION if BOARD_TECHNIKABLE_NRF52840_ZMK
	imply RETENTION_BOOT_MODE if BOARD_TECHNIKABLE_NRF52840_ZMK
```

## config/boards/petejohanson/technikable/board.yml
```yaml
board:
  name: technikable
  vendor: petejohanson
  socs:
    - name: nrf52840
      variants:
        - name: zmk
```
